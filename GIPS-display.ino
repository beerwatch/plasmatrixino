#define PH_R  13
#define PH_1  12
#define PH_2  11
#define PH_3  10

#define ANODES  PORTC
#define ANODDR  DDRC

int phases[] = { PH_R, PH_1, PH_2, PH_3 };
byte cols[ 111 ] = { 0 };
#define BLANK (~0x00)
#define DLY_OVLAY delayMicroseconds(  1 )
#define DLY_BLANK delayMicroseconds(  3 )
#define DLY_ADISP delayMicroseconds( 85 )


/*! \file font5x7.h \brief Graphic LCD Font (Ascii Characters). */
//*****************************************************************************
//
// File Name  : 'font5x7.h'
// Title    : Graphic LCD Font (Ascii Charaters)
// Author   : Pascal Stang
// Date     : 10/19/2001
// Revised    : 10/19/2001
// Version    : 0.1
// Target MCU : Atmel AVR
// Editor Tabs  : 4
//
//*****************************************************************************

#ifndef FONT5X7_H
#define FONT5X7_H

// standard ascii 5x7 font
// defines ascii characters 0x20-0x7F (32-127)
static const byte 
//__attribute__ ((progmem)) 
Font5x7[] = {
  0x00, 0x00, 0x00, 0x00, 0x00,// (space)
  0x00, 0x00, 0x5F, 0x00, 0x00,// !
  0x00, 0x07, 0x00, 0x07, 0x00,// "
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  0x08, 0x1C, 0x2A, 0x08, 0x08 // <-
};

#endif


void setup() {
  // put your setup code here, to run once:
  for( int i=0 ; i < sizeof(phases)/sizeof(phases[0]); ++i )
    digitalWrite( phases[ i ] , LOW );
  for( int i=0 ; i < sizeof(phases)/sizeof(phases[0]); ++i )
    pinMode( phases[ i ] , OUTPUT );
  ANODES = BLANK;
  ANODDR = 0xff;
//    cols[ icol ] = icol-100;
//  delay(1000);

//  return;

  int icol = 0;
  char *p = "";
//  p = "At zijou kocky!";
//  p = "Co chces napsat?";
//  p = "\e\fAhoj, svete! GIPS-16-1 At zijou kocky!";
  p = "\e\fAhoj svete! At zijou kocky!";
//  p = "\f\b\eGreyCortex\b\e ruleZ!";
//  p="\f*\bSedlackovi\b*";

  byte bBold = 0, bCondens = 0, bProport = 0;
  
  while( *p && icol < sizeof(cols)/sizeof(cols[0]) )
  {
    switch ( *p )
    {
      case '\b':
        bBold = 1 - bBold;
        break;

      case '\e':
        bCondens = 1 - bCondens;
        break;

      case '\f':
        bProport = 1 - bProport;
        break;

      default:
        byte * b = Font5x7 + 5 * ( (*p) - 32 );
        for( int jcol = 6 ; --jcol && icol < sizeof(cols)/sizeof(cols[0]) ; ++b )
        {
          if( bProport && ! *b && ( jcol <= 2 || jcol >= 4 ) )
            continue;

          if( !bCondens )
          {
            if( bBold )
            {
              cols[ icol++ ] |= *b;
              cols[ icol++ ] |= *b;
            }
            else
            {
              cols[ icol++ ] |= *b;
            }
          }
          else
          {
            if( bBold )
            {
              if ( jcol == 1 || jcol == 4 )
                --icol;
              cols[ icol++ ] |= *b;
              if ( jcol == 3 || jcol == 299 )
                --icol;
              cols[ icol++ ] |= *b;
            }
            else
            {
              if ( jcol == 2 )
                {--icol;cols[ icol++ ] |= *b;}
              else
                cols[ icol++ ] |= *b;
            }
          }
        }

        if( icol < sizeof(cols)/sizeof(cols[0]) )
          cols[ icol++ ] = 0x00;

    }
    ++p;
  }

//  for( int icol = 0 ; icol < sizeof(cols)/sizeof(cols[0]); ++icol )
//    cols[ icol ] ^= 0xff;
}

void scan()
{
  int ph_cur = 0, ph_new;
  ANODES = BLANK;
//  DLY_BLANK;
  digitalWrite( phases[ ph_cur ] , HIGH );
  DLY_ADISP;
  for( int icol = 0 ; icol < sizeof(cols)/sizeof(cols[0]); ++icol )
  {
    ph_new = 1 + ph_cur; if( ph_new >= sizeof(phases)/sizeof(phases[0]) ) ph_new = 1;
    digitalWrite( phases[ ph_new ] , HIGH );
    DLY_OVLAY;
    digitalWrite( phases[ ph_cur ] , LOW );
    ph_cur = ph_new;
    DLY_BLANK;
    ANODES = ~cols[ sizeof(cols)/sizeof(cols[0]) - 1 - icol ];
    DLY_ADISP;
    ANODES = BLANK;
  }
  digitalWrite( phases[ ph_cur ] , LOW );
}

int iloop = 0;

void loop() {
  // put your main code here, to run repeatedly:

  for( int icol = 0 ; icol < sizeof(cols)/sizeof(cols[0]); ++icol )
  {
//    cols[ icol ] ^= (icol-iloop/7)&64?0x55:0x00;
//    cols[ icol ] ^= (icol/5+iloop/26)&21?((icol/7-iloop/3)&4?0x55:0xaa):0xff;
    cols[ icol ] = ( -iloop/5 - icol );
  }
  
  scan();
  ++iloop;
//  if ( iloop % 32 == 0 )
//  {
//    for( int icol = 0 ; icol < sizeof(cols)/sizeof(cols[0]); ++icol )
//      cols[ icol ] ^= 0xff;
//  }
  
//  delay(15);
}

